## Kconfig
```kconfig
# Copyright (c) 2024 The ZMK Contributors
# SPDX-License-Identifier: MIT

DT_COMPAT_ZMK_HID_TRACKBALL_INTERFACE := zmk,hid-trackball-interface

config ZMK_HID_TRACKBALL_INTERFACE
    bool "Interface with trackballs that send and listen to hid indicator changes."
    default $(dt_compat_enabled,$(DT_COMPAT_ZMK_HID_TRACKBALL_INTERFACE)) 
    imply ZMK_HID_INDICATORS

if ZMK_HID_TRACKBALL_INTERFACE

endif #ZMK_HID_TRACKBALL_INTERFACE
```

## dts/bindings/zmk,hid-trackball-interface.yml
```yaml
# Copyright (c) 2024 The ZMK Contributors
# SPDX-License-Identifier: MIT

description: |
  Interface with trackballs that send and listen to hid indicator changes. 

compatible: "zmk,hid-trackball-interface"

properties:
  tog-scroll-bindings:
    type: phandles
    required: true
    description: The binding that gets executed when the scroll-layer is toggled.
  cyc-dpi-bindings:
    type: phandles
    required: true
    description: The binding that gets executed when the snipe-layer is toggled.
  scroll-layers:
    type: array
    default: []
    description: The layer that execute tog-scroll-bindings when toggled.
  snipe-layers:
    type: array
    default: []
    description: The layer that execute cyc-dpi-bindings when toggled.
  automouse-layer:
    type: int
    default: -1
    description: The layer that should be enabled when the mouse is moved.
  automouse-layer-timeout-ms:
    type: int
    default: 400
    required: false
    description: How many miliseconds of mouse inactivity are required before the automouse-layer is disabled.
```
